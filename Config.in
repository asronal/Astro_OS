## Config.in
```kconfig
menu "Astro OS packages"

source "$BR2_EXTERNAL_ASTRO_PATH/package/libnova/Config.in"
source "$BR2_EXTERNAL_ASTRO_PATH/package/cfitsio/Config.in"
source "$BR2_EXTERNAL_ASTRO_PATH/package/libindi/Config.in"
source "$BR2_EXTERNAL_ASTRO_PATH/package/indi-eqmod/Config.in"
source "$BR2_EXTERNAL_ASTRO_PATH/package/indi-gphoto/Config.in"
source "$BR2_EXTERNAL_ASTRO_PATH/package/astro-core/Config.in"
source "$BR2_EXTERNAL_ASTRO_PATH/package/astro-ui/Config.in"
source "$BR2_EXTERNAL_ASTRO_PATH/package/indi-astro-servo/Config.in"
source "$BR2_EXTERNAL_ASTRO_PATH/package/astro-info/Config.in"

endmenu
```

## configs/pi4_defconfig
```kconfig
BR2_aarch64=y
BR2_cortex_a72=y
BR2_TOOLCHAIN_EXTERNAL=y
BR2_TOOLCHAIN_EXTERNAL_BOOTLIN=y
BR2_TOOLCHAIN_EXTERNAL_BOOTLIN_AARCH64_GLIBC_BLEEDING_EDGE=y
BR2_CCACHE=y
BR2_GLOBAL_PATCH_DIR="board/raspberrypi/patches"
BR2_DOWNLOAD_FORCE_CHECK_HASHES=y
BR2_TARGET_GENERIC_HOSTNAME="astro-os"
BR2_TARGET_GENERIC_ISSUE="Welcome to Astro OS"
BR2_ROOTFS_DEVICE_CREATION_DYNAMIC_EUDEV=y
BR2_TARGET_GENERIC_ROOT_PASSWD="root"
BR2_SYSTEM_DHCP="eth0"
BR2_ROOTFS_USERS_TABLES="$(BR2_EXTERNAL_ASTRO_PATH)/board/astro/users.txt"
BR2_ROOTFS_OVERLAY="$(BR2_EXTERNAL_ASTRO_PATH)/board/astro/rootfs-overlay"
BR2_ROOTFS_POST_BUILD_SCRIPT="board/raspberrypi4-64/post-build.sh $(BR2_EXTERNAL_ASTRO_PATH)/board/astro/post-build.sh"
BR2_ROOTFS_POST_IMAGE_SCRIPT="$(BR2_EXTERNAL_ASTRO_PATH)/board/astro/post-image.sh"
BR2_LINUX_KERNEL=y
BR2_LINUX_KERNEL_CUSTOM_TARBALL=y
BR2_LINUX_KERNEL_CUSTOM_TARBALL_LOCATION="$(call github,raspberrypi,linux,21b410140c47ffab5668399f6f143c7d7b935c8b)/linux-21b410140c47ffab5668399f6f143c7d7b935c8b.tar.gz"
BR2_LINUX_KERNEL_DEFCONFIG="bcm2711"
BR2_LINUX_KERNEL_DTS_SUPPORT=y
BR2_LINUX_KERNEL_INTREE_DTS_NAME="broadcom/bcm2711-rpi-4-b broadcom/bcm2711-rpi-400 broadcom/bcm2711-rpi-cm4 broadcom/bcm2711-rpi-cm4s"
BR2_LINUX_KERNEL_NEEDS_HOST_OPENSSL=y
BR2_PACKAGE_BUSYBOX_SHOW_OTHERS=y
BR2_PACKAGE_XZ=y
BR2_PACKAGE_SOUND_THEME_FREEDESKTOP=y
BR2_PACKAGE_MESA3D=y
BR2_PACKAGE_MESA3D_OPENGL_ES=y
BR2_PACKAGE_MESA3D_GALLIUM_DRIVER_V3D=y
BR2_PACKAGE_WESTON=y
BR2_PACKAGE_BRCMFMAC_SDIO_FIRMWARE_RPI=y
BR2_PACKAGE_BRCMFMAC_SDIO_FIRMWARE_RPI_WIFI=y
BR2_PACKAGE_RPI_FIRMWARE=y
BR2_PACKAGE_RPI_FIRMWARE_VARIANT_PI4=y
BR2_PACKAGE_RPI_FIRMWARE_CONFIG_FILE="$(BR2_EXTERNAL_ASTRO_PATH)/board/astro/config.txt"
BR2_PACKAGE_RPI_FIRMWARE_CMDLINE_FILE="$(BR2_EXTERNAL_ASTRO_PATH)/board/astro/cmdline.txt"
BR2_PACKAGE_E2FSPROGS=y
BR2_PACKAGE_E2FSPROGS_RESIZE2FS=y
BR2_PACKAGE_PARTED=y
BR2_PACKAGE_CA_CERTIFICATES=y
BR2_PACKAGE_WIRELESS_REGDB=y
BR2_PACKAGE_CHRONY=y
BR2_PACKAGE_DNSMASQ=y
BR2_PACKAGE_ETHTOOL=y
BR2_PACKAGE_IPROUTE2=y
BR2_PACKAGE_IW=y
BR2_PACKAGE_OPENSSH=y
BR2_PACKAGE_WPA_SUPPLICANT=y
BR2_PACKAGE_WPA_SUPPLICANT_WPA3=y
BR2_PACKAGE_WPA_SUPPLICANT_CLI=y
BR2_PACKAGE_KMOD_TOOLS=y
BR2_PACKAGE_SUDO=y
BR2_PACKAGE_NANO=y
BR2_TARGET_ROOTFS_EXT2=y
BR2_TARGET_ROOTFS_EXT2_4=y
BR2_TARGET_ROOTFS_EXT2_SIZE="2G"
# BR2_TARGET_ROOTFS_TAR is not set
BR2_PACKAGE_HOST_DOSFSTOOLS=y
BR2_PACKAGE_HOST_GENIMAGE=y
BR2_PACKAGE_HOST_KMOD_XZ=y
BR2_PACKAGE_HOST_MTOOLS=y
BR2_PACKAGE_HOST_QEMU=y
BR2_PACKAGE_HOST_QEMU_LINUX_USER_MODE=y
BR2_PACKAGE_QT6=y
BR2_PACKAGE_QT6BASE_GUI=y
BR2_PACKAGE_QT6BASE_OPENGL=y
BR2_PACKAGE_QT6BASE_OPENGL_ES2=y
BR2_PACKAGE_QT6BASE_FONTCONFIG=y
BR2_PACKAGE_QT6BASE_HARFBUZZ=y
BR2_PACKAGE_QT6BASE_JPEG=y
BR2_PACKAGE_QT6BASE_PNG=y
BR2_PACKAGE_QT6BASE_NETWORK=y
BR2_PACKAGE_QT6BASE_SQL=y
BR2_PACKAGE_QT6BASE_SQLITE=y
BR2_PACKAGE_QT6DECLARATIVE=y
BR2_PACKAGE_QT6DECLARATIVE_QUICK=y
BR2_PACKAGE_QT6SVG=y
BR2_PACKAGE_QT6VIRTUALKEYBOARD=y
BR2_PACKAGE_QT6WAYLAND=y
BR2_PACKAGE_DEJAVU=y
BR2_PACKAGE_SEATD_DAEMON=y
BR2_PACKAGE_WESTON_SIMPLE_CLIENTS=y
BR2_PACKAGE_LIBEV=y
BR2_PACKAGE_GSL=y
BR2_PACKAGE_FFTW=y
BR2_PACKAGE_LIBUSB=y
BR2_PACKAGE_LIBCURL=y
BR2_PACKAGE_JPEG=y
BR2_PACKAGE_LIBRAW=y
BR2_PACKAGE_LIBGPHOTO2=y
BR2_PACKAGE_LIBINDI=y
BR2_PACKAGE_INDI_EQMOD=y
BR2_PACKAGE_INDI_GPHOTO=y
BR2_PACKAGE_ASTRO_CORE=y
BR2_PACKAGE_ASTRO_UI=y
BR2_PACKAGE_INDI_ASTRO_SERVO=y
BR2_PACKAGE_IPTABLES=y
BR2_PACKAGE_ASTRO_INFO=y
```

## package/astro-core/Config.in
```kconfig
config BR2_PACKAGE_ASTRO_CORE
	bool "astro-core"
	depends on BR2_INSTALL_LIBSTDCPP
	select BR2_PACKAGE_LIBNOVA
	help
	  Astro OS sky calculations, and the astro-sky command-line tool.
```

## package/astro-info/Config.in
```kconfig
config BR2_PACKAGE_ASTRO_INFO
	bool "astro-info"
	help
	  Display Astro OS system information.
```

## package/astro-ui/Config.in
```kconfig
config BR2_PACKAGE_ASTRO_UI
	bool "astro-ui"
	depends on BR2_PACKAGE_QT6
	depends on BR2_PACKAGE_QT6_GL_SUPPORTS
	depends on BR2_PACKAGE_LIBINDI
	select BR2_PACKAGE_ASTRO_CORE
	select BR2_PACKAGE_DEJAVU
	select BR2_PACKAGE_READLINE
	select BR2_PACKAGE_TCL
	select BR2_PACKAGE_QT6DECLARATIVE
	select BR2_PACKAGE_QT6DECLARATIVE_QUICK
	select BR2_PACKAGE_QT6VIRTUALKEYBOARD
	select BR2_PACKAGE_QT6WAYLAND
	help
	  Astro OS touch interface.
```

## package/cfitsio/Config.in
```kconfig
config BR2_PACKAGE_CFITSIO
	bool "cfitsio"
	select BR2_PACKAGE_ZLIB
	help
	  Library for reading and writing FITS astronomy image files.

	  https://heasarc.gsfc.nasa.gov/fitsio/
```

## package/indi-astro-servo/Config.in
```kconfig
config BR2_PACKAGE_INDI_ASTRO_SERVO
	bool "indi-astro-servo"
	depends on BR2_PACKAGE_LIBINDI
	help
	  INDI driver for pointing a telescope with two RC servos on a
	  PCA9685 board. For pointing and visual use only, because RC
	  servos are not accurate enough to track long exposures.
```

## package/indi-eqmod/Config.in
```kconfig
config BR2_PACKAGE_INDI_EQMOD
	bool "indi-eqmod"
	depends on BR2_PACKAGE_LIBINDI
	help
	  INDI driver for direct control of Sky-Watcher mounts.
```

## package/indi-gphoto/Config.in
```kconfig
config BR2_PACKAGE_INDI_GPHOTO
	bool "indi-gphoto"
	depends on BR2_PACKAGE_LIBINDI
	select BR2_PACKAGE_LIBGPHOTO2
	select BR2_PACKAGE_LIBRAW
	help
	  INDI driver for DSLR and mirrorless cameras over USB.
```

## package/libindi/Config.in
```kconfig
config BR2_PACKAGE_LIBINDI
	bool "libindi"
	depends on BR2_INSTALL_LIBSTDCPP
	depends on BR2_USE_WCHAR
	depends on BR2_TOOLCHAIN_HAS_THREADS
	select BR2_PACKAGE_CFITSIO
	select BR2_PACKAGE_GSL
	select BR2_PACKAGE_JPEG
	select BR2_PACKAGE_LIBCURL
	select BR2_PACKAGE_LIBEV
	select BR2_PACKAGE_LIBNOVA
	select BR2_PACKAGE_LIBUSB
	select BR2_PACKAGE_ZLIB
	help
	  INDI server, core telescope drivers and simulators, used to
	  control astronomy equipment.

	  https://indilib.org
```

## package/libnova/Config.in
```kconfig
config BR2_PACKAGE_LIBNOVA
	bool "libnova"
	help
	  Celestial mechanics, astrometry and astrodynamics library.

	  http://libnova.sourceforge.net
```
